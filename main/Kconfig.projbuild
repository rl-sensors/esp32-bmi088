## main/Kconfig.projbuild
```kconfig
menu "BMI088-test Configuration"

    config I2C_MASTER_NUM
        int "I2C Master Num"
        default 0
        help
            I2C master line.

    config I2C_FREQUENCY
        int "I2C Frequency"
        default 100000
        help
            I2C frequency. 100k or 400k

    config I2C_MASTER_SCL
        int "SCL GPIO Num"
        default 16
        help
            GPIO number for I2C Master clock line.

    config I2C_MASTER_SDA
        int "SDA GPIO Num"
        default 15
        help
            GPIO number for I2C Master data line.

    config I2C_BMI088_ACC_ADDR
        hex "Accelerometer sensor address"
        default 0x19
        help
            Accelerometer I2C address. 0x18 (SDO1 grounded) or 0x19 (SDO1 pulled high). 0x19 on the breakout from Aliexpress

    config I2C_BMI088_GYRO_ADDR
        hex "Gyro sensor address"
        default 0x69
        help
            Gyro I2C address. 0x69 (default, SDO2 pulled high), or 0x68 (SDO2  grounded). 0x19 on the breakout from Aliexpress

    config READ_SENSOR_DELAY_MS
        int "Delay between sensor reads in milliseconds"
        default 10
        help
            Determines the frequency at which the message with the new sensor readings are enqueued.

    config BLINK_GPIO
        int "Blink GPIO number"
        range 0 48
        default 38
        help
            GPIO number of the LED (38 in v0.1)

endmenu
```
